## Kconfig
```kconfig
config NAGINATA
    bool "Enable Naginata"
    default y

if NAGINATA

choice
    prompt "Naginata default OS"
    default NAGINATA_DEFAULT_OS_MACOS
    help
      薙刀式が起動時に想定するOS。実行時にF15(Windows)/F16(macOS)/F17(Linux)で切り替え可能。

config NAGINATA_DEFAULT_OS_WINDOWS
    bool "Windows"

config NAGINATA_DEFAULT_OS_MACOS
    bool "macOS"

config NAGINATA_DEFAULT_OS_LINUX
    bool "Linux"

endchoice

config NAGINATA_PERSISTENT_STATE
    bool "Naginata Persistent State"
    default y
    select SETTINGS
    help
      Enable persistent storage of Naginata state across reboots.
      This feature requires CONFIG_SETTINGS to be enabled.

config NAGINATA_MIN_OVERLAP_MS
    int "Minimum overlap time for simultaneous keys (ms)"
    default 50
    range 0 1000
    help
      Treat two character keys whose overlap is shorter than this value as
      separate keystrokes. Set to 0 to retain the legacy overlap behavior.

endif # NAGINATA
```
